## zephyr/Kconfig
```kconfig
# The developer-facing surface is deliberately close to zero: add the module to
# west.yml, add `-Dapp_SNIPPET=runtt` to the build, and wrap it in the two-stage
# Dockerfile. No source changes.

menuconfig RUNTT
	bool "runtt device support"
	help
	  Device-side support for the runtt runtime: an SMP management
	  channel, a separate log channel, and a describe command that lets the
	  host identify the firmware contract.

if RUNTT

config RUNTT_CHANNELS
	int "Number of contract channels"
	default 2
	range 1 2
	help
	  2 is the normal case: one SMP management channel and one application
	  log channel. 1 is for single-serial targets (ESP32-C3 class) and for
	  bring-up over a debug probe's UART bridge, where log output shares the
	  management link using the console framing.

config RUNTT_USB
	bool "Set up the USB device for the contract channels"
	default y if DT_HAS_ZEPHYR_CDC_ACM_UART_ENABLED
	depends on USB_DEVICE_STACK_NEXT
	select USBD_CDC_ACM_CLASS
	help
	  Registers every CDC-ACM instance the devicetree declares.

	  Zephyr's own CDC_ACM_SERIAL_INITIALIZE_AT_BOOT cannot be used for a
	  two-channel device: its source says plainly that it "only registers the
	  first CDC-ACM instance", so a board declaring management and log
	  channels enumerates with just one and the log channel never appears.
	  Observed on an RP2040 before this existed.

	  Interface string descriptors are unaffected either way -- those come
	  from each node's devicetree `label` and are handled by the CDC-ACM
	  driver.

if RUNTT_USB

config RUNTT_USB_VID
	hex "USB vendor ID"
	default 0x2fe3
	help
	  Defaults to Zephyr's VID. Customers are expected to ship their own,
	  which is exactly why the contract identifies channels by interface
	  string descriptor rather than by VID/PID.

config RUNTT_USB_PID
	hex "USB product ID"
	default 0x0004

config RUNTT_USB_MANUFACTURER
	string "USB manufacturer string"
	default "runtt"

config RUNTT_USB_PRODUCT
	string "USB product string"
	default "runtt device"

config RUNTT_USB_INIT_PRIORITY
	int "USB init priority"
	default 97
	help
	  Must run after the CDC-ACM instances are initialised and before the
	  application's main().

endif # RUNTT_USB

module = RUNTT
module-str = runtt
source "subsys/logging/Kconfig.template.log_config"

config RUNTT_IMG_MGMT
	bool "Image management (the update half of the contract)"
	default y if $(dt_nodelabel_exists,slot1_partition)
	select MCUMGR_GRP_IMG
	select IMG_MANAGER
	select STREAM_FLASH
	select FLASH
	select FLASH_MAP
	help
	  Enables the SMP image group, which is how firmware is actually
	  delivered. Requires a secondary slot to stage into, so the default
	  follows whether the board's devicetree defines slot1_partition.

	  Boards without it -- a plain rpi_pico, say, whose stock devicetree has
	  a single code partition and no slots -- get transport and identity
	  only. That is a legitimate BRING-UP configuration: it boots standalone
	  with no bootloader, which is exactly what you want while proving USB
	  enumeration, the interface descriptors and the udev rules. It cannot
	  receive an update, and describe advertises as much.

	  Do not ship it. For a deliverable image use a board target with slots
	  (rpi_pico/rp2040/mcuboot) built under sysbuild with MCUboot.

config RUNTT_SMP_DESCRIBE
	bool "Custom SMP describe command"
	default y
	depends on MCUMGR
	help
	  Answers a host query with the contract version, board identity,
	  application version and channel count. This is what turns version skew
	  into a clear error instead of a timeout.

config RUNTT_SMP_GROUP_ID
	int "SMP group id for the describe command"
	default 64
	range 64 65535
	depends on RUNTT_SMP_DESCRIBE
	help
	  64 is MGMT_GROUP_ID_PERUSER, the first id reserved for applications.

config RUNTT_CONTRACT_VERSION
	string "Contract version reported by describe"
	default "2.0.0"
	depends on RUNTT_SMP_DESCRIBE

config RUNTT_SIM_SLOT_SHIM
	bool "Report the DT code partition as the running slot (simulated targets)"
	depends on ARCH_POSIX
	select HAS_FLASH_LOAD_OFFSET
	select USE_DT_CODE_PARTITION
	help
	  Makes img_mgmt buildable on native_sim.

	  img_mgmt refuses to compile without CONFIG_FLASH_LOAD_OFFSET, which it
	  needs to work out which slot the running image occupies. That symbol is
	  gated on HAS_FLASH_LOAD_OFFSET (selected only by real architectures) or
	  on the chosen code partition using the zephyr,mapped-partition
	  compatible. As of Zephyr v4.4.2 native_sim still uses fixed-partitions,
	  so neither holds and the build fails outright.

	  Enabling this selects both, so FLASH_LOAD_OFFSET is derived from
	  /chosen/zephyr,code-partition -- slot 0. On POSIX the value does not
	  affect the link (there is no XIP flash to link into), so its only effect
	  is to let img_mgmt name the running slot.

	  The reported slot is fictional either way: on native_sim the running code
	  is a host ELF, not the contents of slot 0. This makes it consistently
	  fictional rather than unbuildable. Never enable it on real hardware --
	  the dependency on ARCH_POSIX is deliberate.

config RUNTT_IDLE
	bool "This image is the provisioning placeholder"
	default n
	help
	  Set by runtt-idle, the no-op application that ships in slot 0 at
	  provisioning time. Reported over describe so the host can tell a board
	  that is awaiting its first firmware from one running something it does
	  not recognise -- those look identical otherwise, and warrant completely
	  different reactions.

	  Customer firmware should never set this.

config RUNTT_SMP_CAN
	bool "SMP over ISO-TP on a CAN bus"
	default n
	depends on MCUMGR
	depends on CAN && ISOTP
	help
	  A second management transport, for boards reached over CAN rather than
	  USB. Zephyr ships MCUmgr transports for serial, shell, BLE, UDP and
	  LoRaWAN but none for CAN, so this supplies one.

	  It rides ISO-TP (ISO 15765-2) rather than segmenting SMP packets by
	  hand: Zephyr implements it in subsys/canbus/isotp and Linux in the
	  mainline can-isotp module, so both ends get segmentation, flow control
	  and reassembly for free and exchange whole SMP packets.

	  Needs /chosen/zephyr,canbus to name an enabled CAN device, and
	  CONFIG_CAN and CONFIG_ISOTP enabled alongside it.

	  Deliberately `depends on` rather than `select`: ISOTP selects NET_BUF,
	  MCUMGR already depends on NET_BUF, and selecting across that makes
	  Kconfig report a recursive dependency and refuse to configure at all.

if RUNTT_SMP_CAN

config RUNTT_CAN_NODE_ID
	hex "CAN id this device receives SMP requests on"
	default 0x42
	range 0x0 0x7fd
	help
	  A node owns THREE consecutive ids from this one setting: it receives
	  here, replies on this plus one, and sends its console on this plus two.
	  Three ids from one number, deliberately -- the host's placement label
	  (can:<iface>/<node-id>) then carries a single number and the parts
	  cannot drift apart.

	  The console id is reserved whether or not RUNTT_CAN_LOG is set, so
	  that turning logging on later cannot collide with a neighbour already on
	  the bus.

	  Standard 11-bit identifiers only, hence the 0x7fd ceiling: 0x7fe and
	  0x7ff would leave no room for the other two. Give each board on a bus
	  its own id, at least three apart.

config RUNTT_CAN_RX_STACK_SIZE
	int "Stack for the CAN receive thread"
	default 2048
	help
	  The thread copies a received ISO-TP message into an SMP packet and hands
	  it to the MCUmgr core, which processes it on this stack. 2048 rather
	  than something smaller because a USB driver thread at Zephyr's 512-byte
	  default overflowed on the nRF52840 and presented as an MPU fault jumping
	  into a data symbol -- see docs/PROVISIONING.md.

config RUNTT_CAN_RX_THREAD_PRIORITY
	int "Priority of the CAN receive thread"
	default 5

config RUNTT_CAN_TX_TIMEOUT_MS
	int "How long to wait for an ISO-TP send to complete (ms)"
	default 2000
	help
	  A send needs flow-control frames back from the peer, so it stalls
	  indefinitely if nothing is listening. On timeout the response is
	  abandoned and the host retries, which is what its retry logic is for.

config RUNTT_CAN_INIT_PRIORITY
	int "Init priority for the CAN SMP transport"
	default 99
	help
	  After the CAN driver and ISO-TP are up.

config RUNTT_CAN_LOG
	bool "Send the console over CAN as raw frames"
	default y
	depends on LOG && !LOG_MODE_MINIMAL
	help
	  A CAN target has no second channel the way a USB target does, and the
	  single-channel demux cannot stand in: it keys off the console
	  transport's base64-and-CRC framing markers, which SMP over ISO-TP does
	  not have. This gives the console its own path.

	  Frames go out on RUNTT_CAN_NODE_ID + 2 -- the third and last id a
	  node owns. Being the highest of the three, it also has the lowest
	  arbitration priority, so an upload in progress wins the bus against
	  chatty logs.

	  RAW FRAMES RATHER THAN ISO-TP, DELIBERATELY. ISO-TP waits for the
	  receiver's flow-control frame, so logging over it with no host attached
	  would block, and a blocking log backend deadlocks boot. These frames are
	  fire-and-forget and are DROPPED when no mailbox is free. Lossy under
	  backpressure is the intent: a mangled line is a far better failure than
	  a board that will not start.

if RUNTT_CAN_LOG

config RUNTT_CAN_LOG_BUF_SIZE
	int "Formatting buffer for the CAN log backend"
	default 64
	help
	  Log lines are formatted here before being cut into 8-byte frames. This
	  bounds the formatting, not the line: longer lines are emitted in
	  several passes.

config RUNTT_CAN_LOG_QUEUE_DEPTH
	int "Frames buffered between the logger and the bus"
	default 32
	help
	  The lossy boundary. A log call puts a frame here without blocking; the
	  sender thread drains it with a blocking send. Frames are dropped only
	  when this is full, which means the bus genuinely cannot keep up.

	  Do not set this to 0 hoping to send inline. can_send() with K_NO_WAIT
	  fails with -EAGAIN whenever no mailbox is free, and a mailbox frees only
	  once the frame is on the wire -- which discards nearly everything.

config RUNTT_CAN_LOG_TX_STACK_SIZE
	int "Stack for the CAN log sender thread"
	default 768
	help
	  It only pops a frame and calls can_send(), so this is small.

config RUNTT_CAN_LOG_TX_THREAD_PRIORITY
	int "Priority of the CAN log sender thread"
	default 10
	help
	  Below the SMP receive thread: management traffic should preempt logs,
	  matching the arbitration priority the id ordering already gives.

config RUNTT_CAN_LOG_TX_TIMEOUT_MS
	int "How long the sender waits for a mailbox (ms)"
	default 100
	help
	  Bounded so a wedged controller cannot park the sender thread forever.
	  Nothing upstream waits on this, so it can afford to be patient.

config RUNTT_CAN_LOG_INIT_PRIORITY
	int "Init priority for the CAN log backend"
	default 99
	help
	  Must be at or after RUNTT_CAN_INIT_PRIORITY: that is what starts
	  the CAN controller, and this only borrows it. Until this runs, frames
	  are discarded rather than sent to an unstarted device.

endif # RUNTT_CAN_LOG

endif # RUNTT_SMP_CAN

config RUNTT_IDENTITY
	bool "Per-board identity read from flash"
	default y
	depends on FLASH_MAP
	select CRC
	help
	  Reads a 32-byte record from the start of `storage_partition` carrying
	  this board's CAN node id and serial, so that ONE firmware image serves a
	  whole fleet.

	  Without this a CAN node id is a Kconfig symbol, which makes the built
	  image board-specific -- and since firmware ships as an OCI image, that
	  makes the SERVICE IMAGE board-specific too. A fleet of N boards becomes
	  N images in the registry with deltas against the wrong baselines.

	  The record lives outside both MCUboot slots, so a firmware update cannot
	  cost a board its address. It is not code and is deliberately not covered
	  by MCUboot's signature.

	  A board with no valid record uses the built-in defaults, which is what
	  keeps a plain `west build`, native_sim and the CI gates working with
	  nothing provisioned. Boards with no storage partition at all compile to
	  the same defaults rather than failing to build.

	  Write a record with scripts/make-identity.py.

config RUNTT_IDENTITY_INIT_PRIORITY
	int "Init priority for reading the identity record"
	default 90
	depends on RUNTT_IDENTITY
	help
	  Must be BEFORE anything that consumes identity -- notably
	  RUNTT_CAN_INIT_PRIORITY, since the CAN transport reads the node id
	  when it binds its filters.

config RUNTT_CONFIRM_DEADLINE
	bool "Reboot an unconfirmed image so MCUboot can revert it"
	# OFF on simulated targets, and not merely as a precaution:
	# MCUBOOT_IMG_MANAGER is set on native_sim too (RUNTT_SIM_SLOT_SHIM makes
	# img_mgmt buildable there), so without this line the deadline ships in
	# the native_sim fixture that runtt's e2e gates consume. There is no
	# MCUboot in that fixture -- the gate asserts as much, naming swap and
	# confirm "unreachable without a bootloader" -- so a reboot could not
	# revert anything, and sys_reboot() on POSIX re-execs the process. The
	# only possible effect is restarting the simulator underneath a gate that
	# is still driving it.
	default n if ARCH_POSIX
	default y
	depends on RUNTT_IMG_MGMT
	depends on MCUBOOT_IMG_MANAGER
	select REBOOT
	help
	  Closes the gap between "MCUboot will revert an unconfirmed image" and
	  "something actually reboots the board".

	  MCUboot reverts AT BOOT, and its design document puts scheduling that
	  boot out of scope. Nothing else schedules it: an image that boots and
	  runs but cannot answer SMP is never confirmed, and runs indefinitely.
	  Observed on a Pico 2 W, which happily ran an unmanageable image for 14
	  minutes and reverted only once an operator reset it. Zephyr's own OTA
	  clients have the same gap -- hawkbit terminates with
	  HAWKBIT_UNCONFIRMED_IMAGE, updatehub returns -EIO, neither reboots.

	  With this enabled, an image that boots unconfirmed gives the host
	  RUNTT_CONFIRM_DEADLINE_SEC to confirm it and otherwise reboots itself,
	  at which point MCUboot reverts.

	  ON BY DEFAULT, deliberately: a safety property that is off by default is
	  not a safety property, and the runtime's documentation promises this
	  recovery. It costs a settled board nothing -- the deadline is armed only
	  while the running image is unconfirmed, which is only the window
	  between a fresh deploy and its confirmation.

	  It does NOT cover firmware that faults before this module initialises,
	  or firmware that does not include this module at all. That needs a
	  hardware watchdog, which is separate per-SoC work: MCUboot's
	  BOOT_WATCHDOG_FEED only feeds an existing watchdog while doing the swap
	  and does not arm one for the application.

config RUNTT_CONFIRM_DEADLINE_SEC
	int "Seconds to wait for the host to confirm"
	default 60
	range 5 3600
	depends on RUNTT_CONFIRM_DEADLINE
	help
	  THE DANGER HERE POINTS THE OTHER WAY TO INTUITION: too SHORT reverts
	  GOOD firmware, turning the safety property into a liability. Measured
	  confirm latency is about 2 seconds, but it is bounded by the host, not
	  by the device -- a loaded machine or a slow container start can take
	  far longer, and nothing on the device can observe that.

	  So this wants to be generously larger than any realistic confirm, and
	  60 s is roughly thirty times the measured figure. Lower it only with a
	  measurement of your own host's confirm latency in hand.

	  Any change here must be tested in BOTH directions on hardware: that a
	  broken image self-reverts, AND that a good image survives the deadline
	  untouched. The second is the one that matters and the one that is easy
	  not to write.

config RUNTT_CONFIRM_DEADLINE_INIT_PRIORITY
	int "Init priority for arming the confirm deadline"
	default 99
	depends on RUNTT_CONFIRM_DEADLINE
	help
	  Late in APPLICATION: reading whether the running image is confirmed
	  goes through the flash driver and the MCUboot image manager, so both
	  must be up first.

config RUNTT_WATCHDOG
	bool "Hardware watchdog, so a halted CPU still reverts"
	default y if $(dt_alias_enabled,watchdog0)
	depends on RUNTT_CONFIRM_DEADLINE
	select WATCHDOG
	help
	  The confirm deadline reboots firmware that runs but cannot be reached.
	  It cannot help firmware whose kernel has STOPPED, and that is the more
	  likely failure: Zephyr's default fatal handler halts
	  (arch_system_halt, kernel/fatal.c) rather than rebooting, so an image
	  that hard faults sits with the CPU stopped and no deadline ever fires.

	  This arms the SoC's watchdog and feeds it from the system workqueue, so
	  a workqueue that stops making progress reboots the board -- and MCUboot
	  reverts an unconfirmed image on that boot.

	  The feed proves the system workqueue is scheduling, which is precisely
	  what the contract needs: both CDC-ACM channels and MCUmgr's os-reset
	  handler run there, so a stalled workqueue means SMP is already dead and
	  the board is already unmanageable. The watchdog fires when nothing else
	  could have saved it.

	  It does NOT cover firmware without this module, or a fault before this
	  module initialises.

	  ONE THING TO KNOW BEFORE ENABLING THIS. A watchdog armed here keeps
	  counting through a soft reset -- measured on both RP2350 and nRF52840 --
	  so it also applies to MCUboot's swap and to the next image's startup.
	  On nRF52840 MCUboot feeds it (BOOT_WATCHDOG_FEED, on by upstream
	  default and verified through a real swap). On RP2 MCUboot CANNOT feed a
	  watchdog it did not arm -- the Zephyr driver refuses -- so
	  RUNTT_WATCHDOG_DISARM_ON_RESET below stops it before the reset instead.
	  Unmitigated, an inherited watchdog caused a spurious revert of one
	  deploy and reset the next image 5.5 s after boot.

	  A consequence that cannot be fully removed: an image which does NOT arm
	  a watchdog, deployed straight after one that does, inherits a live
	  countdown and is reset once a few seconds after boot. Bounded to a
	  single reset -- a watchdog reset resets the watchdog block itself, so it
	  fires once and stops -- and avoided entirely where wdt_disable() works,
	  which is everywhere except nRF52840.

	  `depends on RUNTT_CONFIRM_DEADLINE` because a reboot only helps if
	  something reverts on that boot; without the deadline's premise -- an
	  image that MCUboot will revert -- this is just a reboot.

config RUNTT_WATCHDOG_DISARM_ON_RESET
	bool "Stop the watchdog when the host asks for a reset"
	default y
	depends on RUNTT_WATCHDOG && MCUMGR_GRP_OS
	select MCUMGR_MGMT_NOTIFICATION_HOOKS
	select MCUMGR_GRP_OS_RESET_HOOK
	help
	  The watchdog keeps counting through a soft reset, so without this
	  MCUboot inherits whatever is left of the period and has to complete a
	  swap inside it. Measured on RP2350: an inherited 8 s watchdog
	  interrupted a swap and left a test image confirmed with no revert
	  target.

	  MCUboot cannot fix this on RP2. Its BOOT_WATCHDOG_FEED path calls
	  wdt_feed(), and Zephyr's RP2 driver refuses to feed a watchdog its own
	  instance did not arm. Arming one in MCUboot instead would bootloop any
	  application that does not feed it. So the application stops it on the
	  way out.

	  On nRF52840 this cannot work -- no WDT TASKS_STOP, so wdt_disable()
	  returns -EPERM -- and is not needed, because MCUboot's nrfx feed path
	  is enabled there by upstream default and does protect the swap.
	  Verified on hardware in both directions.

	  Leave it on. It never blocks a reset; failing to disarm is logged and
	  the reset proceeds.

config RUNTT_WATCHDOG_TIMEOUT_MS
	int "Watchdog timeout (ms)"
	default 8000
	range 500 120000
	depends on RUNTT_WATCHDOG
	help
	  Fed every quarter of this, so 8000 means a feed every 2 s and a reboot
	  after 8 s without one.

	  8000 rather than something rounder because RP2040 is the tightest
	  target we build for: errata RP2040-E1 halves its maximum watchdog
	  period, leaving about 8.3 s where RP2350 allows about 16.8 and
	  nRF52840 far more. A default above the RP2040 ceiling would fail
	  wdt_install_timeout() on one board and work on the others, which is
	  the worst shape for a default.

	  Raising it past ~8.3 s therefore means giving up the Pico 1.

config RUNTT_WATCHDOG_INIT_PRIORITY
	int "Init priority for arming the watchdog"
	default 91
	depends on RUNTT_WATCHDOG
	help
	  Early in APPLICATION, and before the transports: the sooner it is
	  armed, the smaller the window in which a fault goes unnoticed. After
	  RUNTT_IDENTITY_INIT_PRIORITY (90) only because there is no reason to
	  precede it.

config RUNTT_HEALTH
	bool "Application liveness watchdog"
	default n
	help
	  SMP echo proves the kernel is alive, not that the application thread
	  is. Enabling this extends the host's confirm gate from "kernel alive"
	  to "application alive", via runtt_health_feed().

endif # RUNTT

# The system workqueue carries more than an application would expect once this
# module is enabled, and Zephyr's 1024-byte default is not enough for it.
#
# Both CDC-ACM instances submit their rx/tx/irq work to the system workqueue
# (CONFIG_USBD_CDC_ACM_WORKQUEUE is off by default), and MCUmgr's os-reset
# handler schedules the reboot there too -- k_work_schedule(&os_mgmt_reset_work,
# ...) in os_mgmt.c. Overflow that stack and the queue's thread dies, taking SMP,
# log output and the pending reboot with it. USB *interrupts* keep running on
# their own stack, so the device still answers control transfers and looks
# healthy to lsusb while being entirely unmanageable -- and, because the reboot
# never fires, unrecoverable without physically replugging the board.
#
# Observed exactly that on an RP2040: an `os reset` alone, with no upload,
# bricked a board running runtt-idle until it was replugged. The template
# application happened to set 2560 in its own prj.conf and so never hit it,
# which is precisely why this belongs to the module rather than to any one app.
#
# configdefault rather than a value in the snippet's .conf: this raises the
# default without preventing an application from choosing a larger one, whereas
# a conf fragment would silently override a deliberately bigger value.
configdefault SYSTEM_WORKQUEUE_STACK_SIZE
	default 2560 if RUNTT
```
